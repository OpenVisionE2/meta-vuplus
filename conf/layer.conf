## conf/layer.conf
```bitbake
# We have a conf and classes directory, append to BBPATH
BBPATH .= ":${LAYERDIR}"

# We have a recipes directory, add to BBFILES
BBFILES += "${LAYERDIR}/recipes-*/*.bb ${LAYERDIR}/recipes-*/*.bbappend \
            ${LAYERDIR}/recipes-*/*/*.bb ${LAYERDIR}/recipes-*/*/*.bbappend \
            ${LAYERDIR}/recipes-*/*/*/*.bb ${LAYERDIR}/recipes-*/*/*/*.bbappend"

METAVUPLUS_BASE := '${@os.path.normpath("${LAYERDIR}/../")}'
# Prevent current directory creeping into sstate objects. Otherwise, building
# in another TOPDIR will cause recipes using this variable to be rebuilt.
METAVUPLUS_BASE[vardepvalue] = 'meta-vuplus'

# Additional license directories.
LICENSE_PATH += "${LAYERDIR}/conf/license"
```

## conf/machine/include/vuxxo.inc
```bitbake
# We know about rtc
MACHINE_FEATURES_BACKFILL_CONSIDERED += "rtc"

KERNELVERSION = "3.9.6"

MACHINE_ESSENTIAL_EXTRA_RDEPENDS += "\
	vuplus-dvb-modules-${MACHINE} \
	gstreamer1.0-libav \
	kernel-module-rtl8192cu \
	firmware-rtl8192cu \
	firmware-rtl8192cufw \
	vuplus-tuner-turbo \
	vuplus-shutdown \
	gstreamer1.0-plugin-dvbmediasink \
	"

EXTRA_IMAGEDEPENDS += "\
	vuplus-hbbtv-dumpait \
	vuplus-tuner-turbo \
	"

MTD_KERNEL = "mtd1"
MTD_ROOTFS = "mtd0"
KERNEL_FILE = "kernel_cfe_auto.bin"
ROOTFS_FILE = "root_cfe_auto.jffs2"

TARGET_ARCH = "mipsel"
DEFAULTTUNE = "mips32el"

DVBMEDIASINK_CONFIG = "--with-wmv --with-pcm --with-eac3 --with-amr"

PREFERRED_VERSION_linux-vuplus = "${KERNELVERSION}"

PREFERRED_PROVIDER_virtual/kernel = "linux-vuplus"

PREFERRED_PROVIDER_virtual/blindscan-dvbc = "vuplus-blindscan-utils-${MACHINE}"
PREFERRED_PROVIDER_virtual/blindscan-dvbs = "vuplus-blindscan-utils-${MACHINE}"

IMAGE_FSTYPES ?= "ubi"

MKUBIFS_ARGS = "-m 2048 -e 126976 -c 4096 -F"
UBINIZE_ARGS = "-m 2048 -p 128KiB"

EXTRA_IMAGECMD_COMPAT = " --eraseblock=0x20000 -n -l "

IMAGE_CMD_ubifs_prepend = " \
	rm -rf ${IMAGE_ROOTFS}/boot/*; \
	rm -rf ${IMAGE_ROOTFS}/tmp/*; \
	"

FORCE_REBOOT_OPTION ?= "reboot"

IMAGEDIR = "vuplus/${UPDATE_DIR}"

IMAGE_CMD_ubi_append = " \
	mkdir -p ${IMGDEPLOYDIR}/${IMAGEDIR}; \
	cp -f ${IMGDEPLOYDIR}/${IMAGE_NAME}${IMAGE_NAME_SUFFIX}.ubi ${IMGDEPLOYDIR}/${IMAGEDIR}/root_cfe_auto.jffs2; \
	gzip -f -9c ${DEPLOY_DIR_IMAGE}/vmlinux-${MACHINE}.bin > ${IMGDEPLOYDIR}/${IMAGEDIR}/kernel_cfe_auto.bin; \
	touch ${IMGDEPLOYDIR}/${IMAGEDIR}/${FORCE_REBOOT_OPTION}.update; \
	echo ${IMAGE_NAME} > ${IMGDEPLOYDIR}/${IMAGEDIR}/imageversion; \
	echo "https://forum.openvision.tech/app.php/donate" > ${IMGDEPLOYDIR}/${IMAGEDIR}/donate.txt; \
	rm -f ${IMGDEPLOYDIR}/*.zip; \
	cd ${IMGDEPLOYDIR}; \
	zip ${IMAGE_NAME}_usb.zip ${IMAGEDIR}/*; \
	rm -f ${DEPLOY_DIR_IMAGE}/*.ubi; \
	rm -f ${DEPLOY_DIR_IMAGE}/*.ubifs; \
	rm -rf vuplus; \
	"

MACHINE_FEATURES += "alsa usbhost switchoff osdposition hdmicec ci blindscan-tbs vuplus HDMI SCART"

require conf/machine/include/tune-mips32.inc

BOX_BRAND = "vuplus"

STB_PLATFORM = "vu1gen"

BLINDSCAN_BINARY = "vuplus_blindscan"

RCNAME ?= "vu"
```

## conf/machine/include/vuxxo2-new.inc
```bitbake
require conf/machine/include/vuxxo2.inc

PREFERRED_PROVIDER_virtual/egl ?= "libgles-${MACHINE}"
PREFERRED_PROVIDER_virtual/libgles2 ?= "libgles-${MACHINE}"

MACHINE_ESSENTIAL_EXTRA_RDEPENDS += "\
	libgles-${MACHINE} \
	libvupl-${MACHINE} \
	libvugles2-mipsel \
	"

MACHINE_FEATURES += "transcoding streamproxy blindscan-dvbs ctrlrc ci dvbproxy RCA"
```

## conf/machine/include/vuxxo2.inc
```bitbake
# We know about rtc
MACHINE_FEATURES_BACKFILL_CONSIDERED += "rtc"

KERNELVERSION = "3.13.5"

MACHINE_ESSENTIAL_EXTRA_RDEPENDS += "\
	vuplus-dvb-modules-${MACHINE} \
	gstreamer1.0-libav \
	kernel-module-rtl8192cu \
	firmware-rtl8192cu \
	firmware-rtl8192cufw \
	vuplus-tuner-turbo \
	vuplus-shutdown \
	gstreamer1.0-plugin-dvbmediasink \
	"

EXTRA_IMAGEDEPENDS += "\
	enigma2-plugin-systemplugins-firmwareupgrade \
	enigma2-plugin-systemplugins-remotecontrolcode \
	vuplus-hbbtv-dumpait \
	vuplus-tuner-turbo \
	"

MTD_KERNEL = "mtd2"
MTD_ROOTFS = "mtd0"
KERNEL_FILE = "kernel_cfe_auto.bin"
ROOTFS_FILE = "root_cfe_auto.bin"

TARGET_ARCH = "mipsel"
DEFAULTTUNE = "mips32el"

DVBMEDIASINK_CONFIG = "--with-wmv --with-pcm --with-eac3 --with-amr"

PREFERRED_VERSION_linux-vuplus = "${KERNELVERSION}"

PREFERRED_PROVIDER_virtual/kernel = "linux-vuplus"

PREFERRED_PROVIDER_virtual/blindscan-dvbc = "vuplus-blindscan-utils-${MACHINE}"
PREFERRED_PROVIDER_virtual/blindscan-dvbs = "vuplus-blindscan-utils-${MACHINE}"

PREFERRED_PROVIDER_virtual/egl = "libgles-${MACHINE}"
PREFERRED_PROVIDER_virtual/libgles2 = "libgles-${MACHINE}"

IMAGE_FSTYPES ?= "ubi"

MKUBIFS_ARGS = "-m 2048 -e 126976 -c ${MKFS_UBI_MAX_ERASE_BLK_COUNT}"
UBINIZE_ARGS = "-m 2048 -p 128KiB"

EXTRA_IMAGECMD_COMPAT = " --eraseblock=0x20000 -n -l "

IMAGE_CMD_ubi_prepend = " \
	cp -f ${IMAGE_ROOTFS}/tmp/vmlinux.gz ${IMGDEPLOYDIR}/${IMAGE_NAME}.vmlinux.gz; \
	cp -f ${IMAGE_ROOTFS}/boot/initrd_cfe_auto.bin ${IMGDEPLOYDIR}/${IMAGE_NAME}.initrd_cfe_auto.bin; \
	rm -rf ${IMAGE_ROOTFS}/tmp/*; \
	rm -rf ${IMAGE_ROOTFS}/boot/initrd_cfe_auto.bin; \
	"

FORCE_REBOOT_OPTION ?= "reboot"

IMAGEDIR = "vuplus/${UPDATE_DIR}"

IMAGE_CMD_ubi_append = " \
	mkdir -p ${IMGDEPLOYDIR}/${IMAGEDIR}; \
	cp -f ${IMGDEPLOYDIR}/${IMAGE_NAME}${IMAGE_NAME_SUFFIX}.ubi ${IMGDEPLOYDIR}/${IMAGEDIR}/root_cfe_auto.bin; \
	cp -f ${IMGDEPLOYDIR}/${IMAGE_NAME}.vmlinux.gz ${IMGDEPLOYDIR}/${IMAGEDIR}/kernel_cfe_auto.bin; \
	cp -f ${IMGDEPLOYDIR}/${IMAGE_NAME}.initrd_cfe_auto.bin ${IMGDEPLOYDIR}/${IMAGEDIR}/initrd_cfe_auto.bin; \
	touch ${IMGDEPLOYDIR}/${IMAGEDIR}/${FORCE_REBOOT_OPTION}.update; \
	rm -f ${IMGDEPLOYDIR}/*.zip; \
	cd ${IMGDEPLOYDIR}; \
	zip ${IMAGE_NAME}_usb.zip ${IMAGEDIR}/*; \
	rm -f ${DEPLOY_DIR_IMAGE}/*.ubi; \
	rm -f ${DEPLOY_DIR_IMAGE}/*.ubifs; \
	rm -rf vuplus; \
	"

MACHINE_FEATURES += "alsa usbhost switchoff osdposition hdmicec fan blindscan-tbs vuplus HDMI"

require conf/machine/include/tune-mips32.inc

HOSTTOOLS += "sshpass"

BOX_BRAND = "vuplus"

STB_PLATFORM = "vu2gen"

EXTRA_ALSA = "vuplus"

BLINDSCAN_BINARY = "vuplus_blindscan"

RCNAME ?= "vu"
```

## conf/machine/include/vuxxo4k.inc
```bitbake
# We know about rtc
MACHINE_FEATURES_BACKFILL_CONSIDERED += "rtc"

MACHINE_ESSENTIAL_EXTRA_RDEPENDS += "\
	${@bb.utils.contains("MACHINE_FEATURES", "dvbproxy", "vuplus-dvb-proxy-${MACHINE} libgles-${MACHINE} libvupl-${MACHINE} libvugles2 vuplus-platform-util-${MACHINE}", "vuplus-dvb-modules-${MACHINE}", d)} \
	kernel-module-rtl8192cu \
	firmware-rtl8192cu \
	firmware-rtl8192cufw \
	${@bb.utils.contains_any("MACHINE", "vuuno4kse vuultimo4k vuduo4k vuduo4kse", "vuplus-hdmi-in-helper", "", d)} \
	vuplus-tuner-turbo \
	vuplus-tuner-turbo2 \
	vuplus-shutdown \
	"

EXTRA_IMAGEDEPENDS += "\
	vuplus-tuner-turbo \
	vuplus-tuner-turbo2 \
	${@bb.utils.contains("MACHINE_FEATURES", "bcmwifi", "vuplus-wifi-util-${MACHINE}", "", d)} \
	"

IMAGE_INSTALL_append = " \
	vuplus-initrd-${MACHINE} \
	vuplus-bluetooth-util-${MACHINE} \
	"

#IMAGE_FSTYPES += "ext4"

TARGET_ARCH = "arm"
DEFAULTTUNE = "armv7ahf-neon"

DVBMEDIASINK_CONFIG = "--with-wmv --with-pcm --with-eac3 --with-h265 --with-dtsdownmix --with-amr --with-dts"

PREFERRED_PROVIDER_virtual/kernel = "linux-vuplus"

PREFERRED_PROVIDER_virtual/blindscan-dvbc = "vuplus-blindscan-utils-${MACHINE}"
PREFERRED_PROVIDER_virtual/blindscan-dvbs = "vuplus-blindscan-utils-${MACHINE}"

PREFERRED_PROVIDER_virtual/egl = "libgles-${MACHINE}"
PREFERRED_PROVIDER_virtual/libgles2 = "libgles-${MACHINE}"

IMAGE_FSTYPES ?= "tar.bz2"

FORCE_REBOOT_OPTION ?= "reboot"

IMAGEDIR = "vuplus/${UPDATE_DIR}"

IMAGE_CMD_tar_prepend = " \
        mkdir -p ${IMGDEPLOYDIR}/${IMAGEDIR}; \
        cp -f ${IMAGE_ROOTFS}/tmp/zImage ${IMGDEPLOYDIR}/${IMAGEDIR}/kernel_auto.bin; \
        cp -f ${IMAGE_ROOTFS}/boot/initrd_auto.bin ${IMGDEPLOYDIR}/${IMAGEDIR}/initrd_auto.bin; \
	touch ${IMGDEPLOYDIR}/${IMAGEDIR}/${FORCE_REBOOT_OPTION}.update; \
	touch ${IMGDEPLOYDIR}/${IMAGEDIR}/mkpart.update; \
	echo ${IMAGE_NAME} > ${IMGDEPLOYDIR}/${IMAGEDIR}/imageversion; \
	echo "https://forum.openvision.tech/app.php/donate" > ${IMGDEPLOYDIR}/${IMAGEDIR}/donate.txt; \
        rm -f ${IMAGE_ROOTFS}/boot/initrd_auto.bin; \
        cd ${IMAGE_ROOTFS}; \
	rm -rf ${IMAGE_ROOTFS}/tmp/*; \
        tar -cvf ${IMGDEPLOYDIR}/rootfs.tar -C ${IMAGE_ROOTFS} .; \
        mv -f ${IMGDEPLOYDIR}/rootfs.tar ${IMGDEPLOYDIR}/${IMAGEDIR}/rootfs.tar; \
        bzip2 ${IMGDEPLOYDIR}/${IMAGEDIR}/rootfs.tar; \
	rm -f ${IMGDEPLOYDIR}/*.zip; \
        cd ${IMGDEPLOYDIR}; \
        zip ${IMAGE_NAME}_usb.zip ${IMAGEDIR}/*; \
	rm -f ${DEPLOY_DIR_IMAGE}/*.tar.bz2; \
        rm -rf vuplus; \
	"

MACHINE_FEATURES += "alsa usbhost switchoff osdposition hdmicec ci dvbproxy blindscan-tbs vuplus emmc mmc dvb-c blindscan-dvbc blindscan-dvbs ctrlrc bluetooth HDMI"

KERNEL_FILE = "kernel_auto.bin"
ROOTFS_FILE = "rootfs.tar.bz2"
MTD_BLACK  = "mmcblk0"

require conf/machine/include/arm/arch-armv7a.inc

BOX_BRAND = "vuplus"

STB_PLATFORM = "vu4kgen"

EXTRA_ALSA = "vuplus"

EXTRA_OECONF_append_pn-transtreamproxy = " --enable-ext-pid"

BLINDSCAN_BINARY = "vuplus_blindscan"

RCNAME ?= "vu"
```

## conf/machine/vuduo.conf
```bitbake
#@TYPE: Machine
#@NAME: Vu+ Duo
#@DESCRIPTION: Machine configuration for the Vu+ Duo

UPDATE_DIR = "duo"

require conf/machine/include/vuxxo.inc

MACHINE_FEATURES += "textlcd fanctrl YUV"

FLASHSIZE = "128"

CHIPSET = "bcm7335"
```

## conf/machine/vuduo2.conf
```bitbake
#@TYPE: Machine
#@NAME: Vu+ Duo2
#@DESCRIPTION: Machine configuration for the Vu+ Duo2

UPDATE_DIR = "duo2"

require conf/machine/include/vuxxo2-new.inc

IMAGE_INSTALL_append = " \
	vuplus-initrd-${MACHINE} \
	vuplus-coldboot \
	"

MACHINE_ESSENTIAL_EXTRA_RDEPENDS += "\
	kernel-module-extrawlan-rt3070 \
	firmware-rt3070 \
	"

MACHINE_FEATURES += "dvb-c blindscan-dvbc wol bwlcd140 SCART YUV"

SOC_FAMILY = "bcm7424"

MKFS_UBI_MAX_ERASE_BLK_COUNT = "8192"

RCNAME = "vu3"

DISPLAY_MODEL = "Duo²"
```

## conf/machine/vuduo4k.conf
```bitbake
#@TYPE: Machine
#@NAME: Vu+ Duo4k
#@DESCRIPTION: Machine configuration for the Vu+ Duo4k

UPDATE_DIR = "duo4k"

MTD_KERNEL = "mmcblk0p6"

require conf/machine/include/vuxxo4k.inc

DVBMEDIASINK_CONFIG += " --with-vb6 --with-vb8 --with-vb9 --with-spark"

IMAGE_INSTALL_append += "\
	vuplus-wifi-util-${MACHINE} \
	"

MACHINE_FEATURES += "dvb-c blindscan-dvbc blindscan-dvbs ctrlrc transcoding streamproxy mmc bcmwifi colorlcd480 minitv quadpip"

CHIPSET = "bcm7278"

FORCE_REBOOT_OPTION = "reboot"

PREFERRED_VERSION_linux-vuplus = "4.1.45"
```

## conf/machine/vuduo4kse.conf
```bitbake
#@TYPE: Machine
#@NAME: Vu+ Duo4kSE
#@DESCRIPTION: Machine configuration for the Vu+ Duo4kSE

KERNELVERSION = "4.1.45"

UPDATE_DIR = "duo4kse"

MTD_KERNEL = "mmcblk0p6"
MTD_ROOTFS = "mmcblk0p9"

require conf/machine/include/vuxxo4k.inc

DVBMEDIASINK_CONFIG += "--with-vb6 --with-vb8 --with-vb9 --with-spark"

IMAGE_INSTALL_append = " \
	vuplus-wifi-util-${MACHINE} \
	"

MACHINE_FEATURES += "transcoding streamproxy colorlcd480 minitv quadpip hdmi-in-helper HDMI-IN-FHD"

SOC_FAMILY = "bcm7444"

PREFERRED_VERSION_linux-vuplus = "${KERNELVERSION}"

RCNAME = "vu4"

DVBSKYPROVIDER = "kernel"
```

## conf/machine/vusolo.conf
```bitbake
#@TYPE: Machine
#@NAME: Vu+ Solo
#@DESCRIPTION: Machine configuration for the Vu+ Solo

UPDATE_DIR = "solo"

require conf/machine/include/vuxxo.inc

MACHINE_FEATURES += "textlcd eDBoxLCD"

FLASHSIZE = "128"

SOC_FAMILY = "bcm7325"

DISPLAY_MODEL = "Solo"
```

## conf/machine/vusolo2.conf
```bitbake
#@TYPE: Machine
#@NAME: Vu+ Solo2
#@DESCRIPTION: Machine configuration for the Vu+ Solo2

UPDATE_DIR = "solo2"

require conf/machine/include/vuxxo2.inc

PREFERRED_PROVIDER_virtual/egl = "libgles-${MACHINE}"
PREFERRED_PROVIDER_virtual/libgles2 = "libgles-${MACHINE}"

IMAGE_INSTALL_append = " vuplus-initrd-${MACHINE}"

MACHINE_ESSENTIAL_EXTRA_RDEPENDS += "\
	libgles-${MACHINE} \
	libvupl-${MACHINE} \
	libvugles2 \
	"

MACHINE_FEATURES += "textlcd transcoding streamproxy blindscan-dvbs ctrlrc ci dvbproxy SCART RCA"

SOC_FAMILY = "bcm7356"

MKFS_UBI_MAX_ERASE_BLK_COUNT = "4096"
```

## conf/machine/vusolo4k.conf
```bitbake
#@TYPE: Machine
#@NAME: Vu+ Solo4k
#@DESCRIPTION: Machine configuration for the Vu+ Solo4k

UPDATE_DIR = "solo4k"

MTD_KERNEL = "mmcblk0p1"
MTD_ROOTFS = "mmcblk0p4"

require conf/machine/include/vuxxo4k.inc

DVBMEDIASINK_CONFIG += " --with-vb6 --with-vb8 --with-spark"

MACHINE_FEATURES += " transcoding streamproxy colorlcd480 minitv quadpip"

CHIPSET = "bcm7376"

FORCE_REBOOT_OPTION = "reboot"

PREFERRED_VERSION_linux-vuplus = "3.14.28"
```

## conf/machine/vusolose.conf
```bitbake
#@TYPE: Machine
#@NAME: Vu+ SoloSE
#@DESCRIPTION: Machine configuration for the Vu+ SoloSe

UPDATE_DIR = "solose"

require conf/machine/include/vuxxo2-new.inc

IMAGE_INSTALL_append = " vuplus-initrd-${MACHINE}"

MACHINE_FEATURES += "dvb-c blindscan-dvbc textlcd"

SOC_FAMILY = "bcm7241"

MKFS_UBI_MAX_ERASE_BLK_COUNT = "4096"

FORCE = "yes"
FORCE_REBOOT_OPTION = "force"

DISPLAY_MODEL = "Solo SE"
```

## conf/machine/vuultimo.conf
```bitbake
#@TYPE: Machine
#@NAME: Vu+ Ultimo
#@DESCRIPTION: Machine configuration for the Vu+ Ultimo

UPDATE_DIR = "ultimo"

require conf/machine/include/vuxxo.inc

MACHINE_FEATURES += "dvb-c blindscan-dvbc blindscan-dvbs ctrlrc bwlcd255 fan RCA YUV"

SOC_FAMILY = "bcm7413"

RCNAME = "vu2"

DISPLAY_MODEL = "Ultimo"
```

## conf/machine/vuultimo4k.conf
```bitbake
#@TYPE: Machine
#@NAME: Vu+ Ultimo4k
#@DESCRIPTION: Machine configuration for the Vu+ Ultimo4k

UPDATE_DIR = "ultimo4k"

MTD_KERNEL = "mmcblk0p1"
MTD_ROOTFS = "mmcblk0p4"

require conf/machine/include/vuxxo4k.inc

DVBMEDIASINK_CONFIG += "--with-vb6 --with-vb8 --with-vb9 --with-spark"

IMAGE_INSTALL_append = " \
	vuplus-wifi-util-${MACHINE} \
	"

MACHINE_FEATURES += "transcoding streamproxy bcmwifi colorlcd800 minitv wowl quadpip hdmi-in-helper HDMI-IN-FHD"

SOC_FAMILY = "bcm7444"

PREFERRED_VERSION_linux-vuplus = "3.14.28"
```

## conf/machine/vuuno.conf
```bitbake
#@TYPE: Machine
#@NAME: Vu+ Uno
#@DESCRIPTION: Machine configuration for the Vu+ Uno

UPDATE_DIR = "uno"

require conf/machine/include/vuxxo.inc

MACHINE_FEATURES += "textlcd dvb-c blindscan-dvbc blindscan-dvbs ctrlrc fan RCA"

FLASHSIZE = "128"

SOC_FAMILY = "bcm7413"
```

## conf/machine/vuuno4k.conf
```bitbake
#@TYPE: Machine
#@NAME: Vu+ Uno4k
#@DESCRIPTION: Machine configuration for the Vu+ Uno4k

KERNELVERSION = "3.14.28"

UPDATE_DIR = "uno4k"

MTD_KERNEL = "mmcblk0p1"
MTD_ROOTFS = "mmcblk0p4"

require conf/machine/include/vuxxo4k.inc

DVBMEDIASINK_CONFIG += "--with-vb6 --with-vb8 --with-vb9 --with-spark"

MACHINE_FEATURES += "transcoding streamproxy minitv quadpip AV_JACK"

SOC_FAMILY = "bcm7252S"

PREFERRED_VERSION_linux-vuplus = "${KERNELVERSION}"

FORCE = "yes"
FORCE_REBOOT_OPTION = "force"
```

## conf/machine/vuuno4kse.conf
```bitbake
#@TYPE: Machine
#@NAME: Vu+ Uno4kSE
#@DESCRIPTION: Machine configuration for the Vu+ Uno4kSE

KERNELVERSION = "4.1.20"

UPDATE_DIR = "uno4kse"

MTD_KERNEL = "mmcblk0p1"
MTD_ROOTFS = "mmcblk0p4"

require conf/machine/include/vuxxo4k.inc

DVBMEDIASINK_CONFIG += "--with-vb6 --with-vb8 --with-vb9 --with-spark"

MACHINE_FEATURES += "transcoding streamproxy colorlcd400 minitv quadpip hdmi-in-helper HDMI-IN-FHD"

SOC_FAMILY = "bcm7252s"

IMAGE_FSTYPES =+ "ext4"

PREFERRED_VERSION_linux-vuplus = "${KERNELVERSION}"

RCNAME = "vu4"
```

## conf/machine/vuzero.conf
```bitbake
#@TYPE: Machine
#@NAME: Vu+ Zero
#@DESCRIPTION: Machine configuration for the Vu+ Zero

UPDATE_DIR = "zero"

require conf/machine/include/vuxxo2.inc

DVBMEDIASINK_CONFIG += "--with-h265"

IMAGE_INSTALL_append = " \
	vuplus-initrd-${MACHINE} \
	"

MACHINE_FEATURES += "ctrlrc vupluszap AV_JACK"

SOC_FAMILY = "bcm73625"

MKFS_UBI_MAX_ERASE_BLK_COUNT = "4096"

FORCE = "yes"
FORCE_REBOOT_OPTION = "force"
```
