## conf/machine/vuzero4k.conf
```bitbake
#@TYPE: Machine
#@NAME: Vu+ Zero4K
#@DESCRIPTION: Machine configuration for the Vu+ Zero4K

UPDATE_DIR = "zero4k"

MTD_KERNEL = "mmcblk0p4"
MTD_ROOTFS = "mmcblk0p7"

require conf/machine/include/vuxxo4k.inc

DVBMEDIASINK_CONFIG += " --with-vb9"

SOC_FAMILY = "bcm72604"

PREFERRED_VERSION_linux-vuplus = "4.1.20"

FORCE = "yes"
FORCE_REBOOT_OPTION = "force"
```
